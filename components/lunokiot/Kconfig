## components/lunokiot/Kconfig
```kconfig
# https://www.kernel.org/doc/html/latest/kbuild/kconfig-language.html#introduction
menu "lunokIoT"
    config LUNOKIOT_DEBUG
        bool "Enable Serial debug"
        default y
        help
            Enable debug to serial
    choice
        prompt "Device support"
        help
            select Select device to support
        default LUNOKIOT_DEVICE_ESP32
        config LUNOKIOT_DEVICE_ESP32
            bool "ESP-32 based board"
            help
                Generic unspecified ESP32
        config LUNOKIOT_DEVICE_M5STACK_ATOM_LITE
            bool "M5Stack Atom Lite"
            help
                Enable support for M5Stack Atom lite device
        config LUNOKIOT_DEVICE_M5STACK_STICK_C_PLUS
            bool "M5StickC Plus"
            help
                Enable support for M5Stack Stick C Plus
        config LUNOKIOT_DEVICE_LILYGO_TWATCH_2020_V3
            bool "LilyGo T-Watch 2020 v3"
            help
                Enable support for LilyGo T-Watch 2020 v3
    endchoice
endmenu
```

## sdkconfig.defaults
```kconfig
CONFIG_LUNOKIOT_DEVICE_ESP32=y

CONFIG_IDF_CCACHE_ENABLE=1
CONFIG_IDF_TARGET="esp32"

CONFIG_FREERTOS_MAX_TASK_NAME_LEN=32
CONFIG_FREERTOS_HZ=1000

CONFIG_FREERTOS_USE_TRACE_FACILITY=y
CONFIG_FREERTOS_USE_STATS_FORMATTING_FUNCTIONS=y
CONFIG_FREERTOS_VTASKLIST_INCLUDE_COREID=y
CONFIG_FREERTOS_GENERATE_RUN_TIME_STATS=y
CONFIG_FREERTOS_RUN_TIME_STATS_USING_ESP_TIMER=y
CONFIG_ESPTOOLPY_BEFORE_RESET=y
CONFIG_ESPTOOLPY_BEFORE="default_reset"
CONFIG_ESPTOOLPY_AFTER_RESET=y
CONFIG_ESPTOOLPY_AFTER="hard_reset"
CONFIG_ESPTOOLPY_FLASHSIZE_4MB=y
CONFIG_ESPTOOLPY_FLASHSIZE="4MB"

CONFIG_PARTITION_TABLE_CUSTOM=y
CONFIG_PARTITION_TABLE_CUSTOM_FILENAME="./partitions/esp32-pico-d4.csv"
CONFIG_PARTITION_TABLE_FILENAME="./partitions/esp32-pico-d4.csv"
CONFIG_PARTITION_TABLE_OFFSET=0x8000
CONFIG_PARTITION_TABLE_MD5=n

CONFIG_BOOTLOADER_SKIP_VALIDATE_IN_DEEP_SLEEP=y
CONFIG_BOOTLOADER_COMPILER_OPTIMIZATION_SIZE=y
CONFIG_BOOTLOADER_LOG_LEVEL_NONE=y

CONFIG_ESP_SYSTEM_PANIC_PRINT_HALT=y
```
